## meta-raspberrypi/conf/layer.conf
```bitbake
# We have a conf and classes directory, add to BBPATH
BBPATH .= ":${LAYERDIR}"

# We have recipes-* directories, add to BBFILES
BBFILES += "${LAYERDIR}/recipes-*/*/*.bb \
            ${LAYERDIR}/recipes-*/*/*.bbappend"

# Add layer-specific recipes
BBFILES += "${@' '.join('${LAYERDIR}/%s/recipes*/*/*.bb' % layer \
               for layer in BBFILE_COLLECTIONS.split())}"
             
BBFILES += "${@' '.join('${LAYERDIR}/%s/recipes*/*/*.bbappend' % layer \
               for layer in BBFILE_COLLECTIONS.split())}"

BBFILE_COLLECTIONS += "recipes-kernel"
BBFILE_PATTERN_recipes-kernel = "^${LAYERDIR}/"
BBFILE_PRIORITY_recipes-kernel = "6"

LICENSE_PATH += "${LAYERDIR}/"

LAYERSERIES_COMPAT_recipes-kernel = "kirkstone"
```

## meta-tedge-extras/conf/layer.conf
```bitbake
# We have a conf and classes directory, add to BBPATH
BBPATH .= ":${LAYERDIR}"

# We have recipes-* directories, add to BBFILES
BBFILES += "${LAYERDIR}/recipes-*/*/*.bb \
            ${LAYERDIR}/recipes-*/*/*.bbappend"

# Add layer-specific recipes
BBFILES += "${@' '.join('${LAYERDIR}/%s/recipes*/*/*.bb' % layer \
               for layer in BBFILE_COLLECTIONS.split())}"
             
BBFILES += "${@' '.join('${LAYERDIR}/%s/recipes*/*/*.bbappend' % layer \
               for layer in BBFILE_COLLECTIONS.split())}"

BBFILE_COLLECTIONS += "meta-tedge-extras"
BBFILE_PATTERN_meta-tedge-extras = "^${LAYERDIR}/"
BBFILE_PRIORITY_meta-tedge-extras = "6"
LAYERSERIES_COMPAT_meta-tedge-extras = "meta-tedge-common core"
LAYERDEPENDS_meta-tedge-extras = "meta-tedge-common core"

LICENSE_PATH += "${LAYERDIR}/"

LAYERSERIES_COMPAT_meta-tedge-extras = "kirkstone"
```
